	LIST P=16F877A
	#INCLUDE <P16F877A.INC>
	SAYICI1 EQU 0X20
	SAYICI2 EQU 0X21
	ORG 0X000
	GOTO ANA_METOT

ANA_METOT
	BANKSEL TRISB
	CLRF TRISB
	
	BANKSEL PORTB
	CLRF PORTB

	BANKSEL TRISC
	CLRF TRISC

	BANKSEL PORTC
	CLRF PORTC

	CALL TEMIZLE 
	CALL KARAKTERLER

LCD_KARAKTER_GONDER
	BANKSEL PORTC
	MOVWF PORTC
	
	BANKSEL PORTB
	BSF PORTB,4
	
	BSF PORTB,6
	CALL GECIKME
	BCF PORTB,6
	RETURN

LCD_KOMUT_GONDER
	BANKSEL PORTC
	MOVWF PORTC

	BANKSEL PORTB
	BCF PORTB,4
	
	BSF PORTB,6
	CALL GECIKME
	BCF PORTB,6
	RETURN

GECIKME
	MOVLW 0XFF
	MOVWF SAYICI1

TEKRAR1
	MOVLW 0XFF
	MOVWF SAYICI2

TEKRAR2
	DECFSZ SAYICI2,F
	GOTO TEKRAR2
	DECFSZ SAYICI1,F
	GOTO TEKRAR1
	RETURN

TEMIZLE
	MOVLW H'02'
	CALL LCD_KOMUT_GONDER

	MOVLW H'0C'
	CALL LCD_KOMUT_GONDER

	MOVLW H'38'
	CALL LCD_KOMUT_GONDER
	
	RETURN

SATIR2
	MOVLW H'C0'
	CALL LCD_KOMUT_GONDER
	RETURN
	 
KARAKTERLER
	MOVLW A'N'
	CALL LCD_KARAKTER_GONDER

	MOVLW A'I'
	CALL LCD_KARAKTER_GONDER

	MOVLW A'L'
	CALL LCD_KARAKTER_GONDER

	MOVLW A'A'
	CALL LCD_KARAKTER_GONDER
	
	MOVLW A'Y'
	CALL LCD_KARAKTER_GONDER

	MOVLW A' '
	CALL LCD_KARAKTER_GONDER


	MOVLW A'A'
	CALL LCD_KARAKTER_GONDER

	MOVLW A'L'
	CALL LCD_KARAKTER_GONDER

	MOVLW A'T'
	CALL LCD_KARAKTER_GONDER

	MOVLW A'U'	
	CALL LCD_KARAKTER_GONDER

	MOVLW A'G'
	CALL LCD_KARAKTER_GONDER

	CALL SATIR2
	
	MOVLW A'1'
	CALL LCD_KARAKTER_GONDER

	MOVLW A'2'
	CALL LCD_KARAKTER_GONDER

	MOVLW A'3'
	CALL LCD_KARAKTER_GONDER

	RETURN

END